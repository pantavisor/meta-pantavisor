## conf/distro/panta-appengine.conf
```bitbake
require conf/distro/poky.conf
require panta-appengine.inc

DISTRO = "panta-appengine"
DISTRO_NAME = "Pantavisor Appengine Distro"

require conf/distro/panta-version.inc
```

## conf/distro/panta-distro-bsp.conf
```bitbake
orig_PP := "${PREFERRED_PROVIDER_virtual/kernel}"

require conf/distro/poky-tiny.conf

# kirkstone: recipes-pv/busybox/busybox_1.36~pv.1.bb (forked git source)
# scarthgap: poky's busybox_1.36.1.bb + recipes-pv/busybox/busybox_%.bbappend
BUSYBOX_VERSION_kirkstone = "1.36~pv.%"
BUSYBOX_VERSION_scarthgap = "1.36.%"
DISTRO = "panta-distro-bsp"
DISTRO_FEATURES += "pantavisor-kernel"
DISTRO_NAME = "Pantavisor Inintramfs Distro"
DISTRO_VERSION = "${@oe.buildcfg.get_metadata_git_describe(os.path.dirname(os.path.dirname(d.getVar('FILE'))))}"
PREFERRED_PROVIDER_virtual/kernel = "${orig_PP}"
PREFERRED_VERSION_busybox = "${@d.getVar("BUSYBOX_VERSION_${DISTRO_CODENAME}", expand=True)}"
PREFERRED_VERSION_mbedtls = "2.28.%"
TI_COMMON_DEPLOY = "${TMPDIR}/deploy"
```

## conf/distro/panta-distro.conf
```bitbake
require panta-distro.inc

DISTRO = "panta"
DISTRO_NAME = "Pantavisor Remix Distro"
# Use a helper available on both Kirkstone and Scarthgap.
DISTRO_VERSION = "${@bb.process.run(['git', 'describe', '--always', '--dirty'], cwd=d.getVar('META_PANTAVISOR_BASE'))[0].strip()}"

# use custom busybox + mbedtls
BUSYBOX_VERSION_kirkstone = "1.36~pv.%"
BUSYBOX_VERSION_scarthgap = "1.36~pv.%"

PREFERRED_VERSION_busybox = "${@d.getVar("BUSYBOX_VERSION_${DISTRO_CODENAME}", expand=True)}"
PREFERRED_VERSION_mbedtls = "2.28.%"
```
