## conf/distro/panta-distro.inc
```bitbake
require conf/distro/poky.conf
# mandatory class
IMAGE_CLASSES:append = " image-pvrexport"

TCLIBC ?= "musl"

# Enable advisory rootfs manifest audit by default for the panta distro.
# Set 'pv-manifest-strict' (instead of, or in addition to, 'pv-manifest-audit')
# to gate the build on manifest drift.
PANTAVISOR_FEATURES:append = " pv-manifest-audit"
```

## conf/distro/panta-zephyr.conf
```bitbake
require conf/distro/zephyr.conf

DISTRO = "panta-zephyr"
DISTRO_NAME = "Pantavisor MCU Zephyr"
DISTRO_VERSION = "027-rc3"
DISTRO_CODENAME = "panta-zephyr"
```

## conf/distro/panta.conf
```bitbake
require panta-distro.inc

IMAGE_CLASSES += "image-pvrexport"

INITRAMFS_IMAGE = "pantavisor-initramfs"
INITRAMFS_IMAGE_BUNDLE = "1"
INITRAMFS_MULTICONFIG = "pv-initramfs-panta"
INITRAMFS_DEPLOY_DIR_IMAGE = "${TOPDIR}/tmp-${DISTRO_CODENAME}-${INITRAMFS_MULTICONFIG}/deploy/images/${MACHINE}"

DISTRO_FEATURES += "pantavisor-system"

CORE_IMAGE_EXTRA_INSTALL += "u-boot"

IMAGE_BOOT_FILES = "boot.scr;boot/boot.scr"

BUSYBOX_VERSION_kirkstone = "1.35.%"
BUSYBOX_VERSION_scarthgap = "1.36.%"
PREFERRED_VERSION_busybox = "${@d.getVar("BUSYBOX_VERSION_${DISTRO_CODENAME}", expand=True)}"
```

## conf/layer.conf
```bitbake
# We have a conf and classes directory, add to BBPATH
BBPATH .= ":${LAYERDIR}"

META_PANTAVISOR_BASE = "${LAYERDIR}"

# We have recipes-* directories, add to BBFILES
BBFILES += "${LAYERDIR}/recipes-*/*/*.bb \
            ${LAYERDIR}/recipes-*/*/*.bbappend"

BBFILE_COLLECTIONS += "meta-pantavisor"
BBFILE_PATTERN_meta-pantavisor = "^${LAYERDIR}/"
BBFILE_PRIORITY_meta-pantavisor = "5"

LAYERDEPENDS_meta-pantavisor = "core"
LAYERSERIES_COMPAT_meta-pantavisor = "kirkstone scarthgap"


BBFILES_DYNAMIC += "\
	core:${LAYERDIR}/dynamic-layers/core/recipes-*/*/*.bbappend \
	freescale-layer:${LAYERDIR}/dynamic-layers/meta-freescale/recipes-*/*/*.bbappend \
	virtualization-layer:${LAYERDIR}/dynamic-layers/virtualization-layer/recipes-*/*/*.bbappend \
	virtualization-layer:${LAYERDIR}/dynamic-layers/virtualization-layer/recipes-*/*/*.bb \
	freescale-distro:${LAYERDIR}/dynamic-layers/meta-freescale-distro/recipes-*/*/*.bbappend \
	raspberrypi:${LAYERDIR}/dynamic-layers/meta-raspberrypi/recipes-*/*/*.bb \
	raspberrypi:${LAYERDIR}/dynamic-layers/meta-raspberrypi/recipes-*/*/*.bbappend \
	ti-bsp:${LAYERDIR}/dynamic-layers/meta-ti-bsp/recipes-*/*/*.bbappend \
	variscite-bsp:${LAYERDIR}/dynamic-layers/meta-variscite-bsp/recipes-*/*/*.bbappend \
	toradex-bsp-common-layer:${LAYERDIR}/dynamic-layers/meta-toradex-bsp-common/recipes-*/*/*.bbappend \
"

IMAGE_CLASSES += "image_types_vfat"
INHERIT += "pvbase"
```

## conf/machine/dockerarm64.conf
```bitbake
require conf/machine/include/arm/arch-armv8a.inc
require conf/machine/include/bspless.inc
```

## conf/machine/imx8mn-m7.conf
```bitbake
#@TYPE: Machine
#@NAME: imx8mn-m7
#@DESCRIPTION: Machine for i.MX8MN Cortex-M7 core (Variscite SoM)

require conf/machine/include/arm/armv7m/tune-cortexm7.inc

ARCH:imx8mn-m7 = "arm"
```

## conf/machine/include/bspless.inc
```bitbake
MACHINE_FEATURES = ""

IMAGE_FSTYPES += "container tar.bz2"

# Don't include kernels in standard images
RDEPENDS_${KERNEL_PACKAGE_NAME}-base = ""

# Use a common kernel recipe for all QEMU machines
PREFERRED_PROVIDER_virtual/kernel ??= "linux-dummy"

EXTRA_IMAGEDEPENDS += ""

# Example: Disable graphical interface
DISTRO_FEATURES:remove = "x11 wayland"

# Example: Keep it minimal
DISTRO_FEATURES:remove = "opengl alsa"

PACKAGE_EXCLUDE_KERNEL = "1"
```

## conf/machine/native-posix.conf
```bitbake
#@TYPE: Machine
#@NAME: native-posix
#@DESCRIPTION: Zephyr native_posix board - compiles as Linux executable for testing
# Zephyr native_posix uses the host compiler directly. Set minimal
# tune to satisfy OE sanity checker.

DEFAULTTUNE = "x86-64"
require conf/machine/include/x86/arch-x86.inc
TUNE_FEATURES:tune-x86-64 = "m64"

# native_posix builds a Linux executable that needs POSIX APIs (pty.h,
# pthread.h). Override newlib from zephyr distro with glibc.
TCLIBC = "glibc"

# ARCH=posix is for Zephyr cmake only. Don't set it globally or it
# leaks into linux-libc-headers (which has no arch/posix/).
# The zephyr.bbclass sets ARCH from ZEPHYR_BOARD via python.
```

## conf/machine/native-sim.conf
```bitbake
#@TYPE: Machine
#@NAME: native-sim
#@DESCRIPTION: Zephyr native_sim_64 board for local PVCM protocol testing

DEFAULTTUNE = "x86-64"
require conf/machine/include/x86/arch-x86.inc
TUNE_FEATURES:tune-x86-64 = "m64"

TCLIBC = "glibc"
```

## conf/machine/qemu-x86-64-efi.conf
```bitbake
# Copyright (c) 2025-2026 Pantacor Ltd.
# SPDX-License-Identifier: MIT

#@TYPE: Machine
#@NAME: QEMU x86-64 with EFI boot
#@DESCRIPTION: Machine configuration for QEMU x86-64 with UEFI/OVMF firmware
#              and Pantavisor A/B EFI boot partition layout.

DEFAULTTUNE = "core2-64"
require conf/machine/include/x86/tune-corei7.inc

PREFERRED_PROVIDER_virtual/kernel = "linux-yocto"

MACHINE_FEATURES = "efi pcbios"

KERNEL_IMAGETYPE = "bzImage"

SERIAL_CONSOLES = "115200;ttyS0"

IMAGE_FSTYPES = "wic wic.bmap"

WKS_FILE = "pantavisor-efi.wks"

# QEMU options for EFI testing
QB_SYSTEM_NAME = "qemu-system-x86_64"
QB_MACHINE = "-machine q35"
QB_CPU = "-cpu IvyBridge"
QB_MEM = "-m 1024"
QB_DRIVE_TYPE = "/dev/vd"
QB_KERNEL_CMDLINE_APPEND = "console=ttyS0,115200"

# EFI boot components
EXTRA_IMAGEDEPENDS += "pv-efi-boot ovmf"

# OVMF firmware for QEMU
QB_DRIVE_TYPE = "/dev/sda"
```

## conf/machine/x64-efi.conf
```bitbake
# Copyright (c) 2025-2026 Pantacor Ltd.
# SPDX-License-Identifier: MIT

#@TYPE: Machine
#@NAME: x86-64 EFI (QEMU testable)
#@DESCRIPTION: x86-64 machine with linux-yocto kernel, UEFI boot via
#              pv-efi-boot A/B partition layout. Testable with QEMU + OVMF.

DEFAULTTUNE = "core2-64"
require conf/machine/include/x86/tune-corei7.inc

PREFERRED_PROVIDER_virtual/kernel = "linux-yocto"
KMACHINE:x64-efi = "common-pc-64"

MACHINE_FEATURES = "efi pcbios serial"

KERNEL_IMAGETYPE = "bzImage"
KERNEL_EXTRA_FEATURES ?= "cfg/efi.scc cfg/fs/vfat.scc"

# Keep kernel and initramfs separate — UKI assembly combines them.
# Use machine override so distro conf cannot re-enable bundling.
INITRAMFS_IMAGE_BUNDLE:x64-efi = "0"

SERIAL_CONSOLES = "115200;ttyS0"

IMAGE_FSTYPES = "wic wic.bmap"
WKS_FILE = "pantavisor-efi.wks"

# EFI boot components
EXTRA_IMAGEDEPENDS += "pv-efi-boot pv-uki ovmf"

# EFI A/B boot image for pantavisor updates
PVBSP_EFIAB_BOOTIMG = "efi-boot-image-${MACHINE}.vfat"

# QEMU settings for testing with OVMF
QB_SYSTEM_NAME = "qemu-system-x86_64"
QB_MACHINE = "-machine q35"
QB_CPU = "-cpu IvyBridge"
QB_MEM = "-m 1024"
QB_SMP = "-smp 4"
QB_DRIVE_TYPE = "/dev/sda"
QB_KERNEL_CMDLINE_APPEND = "console=ttyS0,115200"
QB_OPT_APPEND = "-nographic -serial mon:stdio"
```

## recipes-pv/pvgo/conf/layer.conf
```bitbake
# pvgo layer - Isolated Go 1.24 toolchain for Pantavisor
BBPATH .= ":${LAYERDIR}"

BBFILES += "${LAYERDIR}/recipes-*/*/*.bb ${LAYERDIR}/recipes-*/*/*.bbappend"
BBFILE_COLLECTIONS += "pvgo"
BBFILE_PATTERN_pvgo = "^${LAYERDIR}/"
BBFILE_PRIORITY_pvgo = "7"

LAYERSERIES_COMPAT_pvgo = "kirkstone scarthgap styhead"
LAYERDEPENDS_pvgo = "core"
```

## wic/pantavisor-efi.wks
```
# Copyright (c) 2025-2026 Pantacor Ltd.
# SPDX-License-Identifier: MIT

# pantavisor-efi.wks — GPT partition layout for Pantavisor EFI boot
#
# Partition 1: ESP — stage 1 bootloader + autoboot.txt (frozen)
# Partition 2: pvboot-a — stage 2 + UKI (A/B slot A)
# Partition 3: pvboot-b — stage 2 + UKI (A/B slot B)
# Partition 4: pvdata — Pantavisor state, containers, volumes

bootloader --ptable gpt

part esp     --source rawcopy --sourceparams="file=efi-esp-image-${MACHINE}.vfat" --ondisk sda --fstype=vfat --active --align 1024 --fixed-size 64M --part-type EF00
part boot_a  --source rawcopy --sourceparams="file=efi-boot-image-${MACHINE}.vfat" --ondisk sda --fstype=vfat --align 1024 --fixed-size 128M
part boot_b  --source rawcopy --sourceparams="file=efi-boot-image-${MACHINE}.vfat" --ondisk sda --fstype=vfat --align 1024 --fixed-size 128M
part /       --source rootfs --ondisk sda --fstype=ext4 --label root --align 1024 --size 2048
```

## wic/rpi-tryboot-ab.wks
```
# short-description: Raspberry Pi A/B tryboot partition layout
# long-description: Creates a partitioned SD card image for Raspberry Pi with
# A/B boot partition support using the tryboot mechanism.
#
# Partition layout:
#   1 (bootsel) - FAT16 - autoboot.txt, bootcode.bin (A/B selector)
#   2 (boot_a)  - FAT32 - kernels, DTBs, config.txt, initramfs
#   3 (boot_b)  - FAT32 - same as boot_a (for A/B switching)
#   4 (root)    - ext4  - rootfs with /trails/0 pvr state

part bootsel --source rawcopy --sourceparams="file=rpi-bootsel.vfat" --ondisk mmcblk0 --fstype=vfat --active --align 4096 --fixed-size 16M
part boot_a  --source rawcopy --sourceparams="file=rpi-boot-image-${MACHINE}.vfat" --ondisk mmcblk0 --fstype=vfat --align 4096 --fixed-size 128M
part boot_b  --source rawcopy --sourceparams="file=rpi-boot-image-${MACHINE}.vfat" --ondisk mmcblk0 --fstype=vfat --align 4096 --fixed-size 128M
part /       --source rootfs --ondisk mmcblk0 --fstype=ext4 --label root --align 4096
```
