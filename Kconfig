## Kconfig
```kconfig
# pantavisor kas choices

choice
	prompt "Select Build Type"
	default BUILD_TYPE_BSP_MULTI

config BUILD_TYPE_BSP_MULTI
	bool "multiconfig"

config BUILD_TYPE_BSP_PLAIN
	bool "singleconfig"

config BUILD_TYPE_APPENGINE
	bool "appengine"

config BUILD_TYPE_APPENGINE_CUSTOM
	bool "appengine-custom"

endchoice

choice
	prompt "Select Codename to build"
	default CODENAME_KIRKSTONE

config CODENAME_KIRKSTONE
	bool "kirkstone"

config CODENAME_SCARTHGAP
	bool "scarthgap"

endchoice

choice
	prompt "Select Build Target"
	default BUILD_BSP

config BUILD_APPENGINE
        bool "pantavisor-appengine"
        depends on BUILD_TYPE_APPENGINE

config BUILD_APPENGINE_IMAGE
        string "Custom Image for Appengine"
        default "core-image-base"
        depends on BUILD_TYPE_APPENGINE_CUSTOM

config BUILD_BSP
	bool "pantavisor-bsp"
        depends on BUILD_TYPE_BSP_PLAIN || BUILD_TYPE_BSP_MULTI

config BUILD_REMIX
	bool "pantavisor-remix"
        depends on BUILD_TYPE_BSP_PLAIN || BUILD_TYPE_BSP_MULTI

config BUILD_STARTER
	bool "pantavisor-starter"

endchoice

config KAS_LOCAL_BUILD_BSP
	string
	default "DISTROOVERRIDES .= \":pvbsp\"" if BUILD_BSP


config KAS_TARGET_BUILD
	string
	default "pantavisor-bsp" if BUILD_BSP
	default "pantavisor-remix" if BUILD_REMIX
	default "pantavisor-starter" if BUILD_STARTER
	default "pantavisor-appengine-distro" if BUILD_APPENGINE
	default BUILD_APPENGINE_IMAGE if BUILD_TYPE_APPENGINE_CUSTOM

config PVBSP_FIRMWARE_PKG
	string "BSP Firmware"
	default "${MACHINE_FIRMWARE} linux-firmware"
	depends on BUILD_BSP

menu "Containers"
	depends on BUILD_REMIX

config USE_PVROOT_IMAGE
	bool "Make root container"
	default y
	depends on BUILD_REMIX

config PVROOT_IMAGE
	string
	default "yes"
	depends on USE_PVROOT_IMAGE

config PVROOT_IMAGE_BSP
	string "Root Container Image"
	default "core-image-base"
	depends on USE_PVROOT_IMAGE

config EXTRA_IMAGE_FEATURES
	string "Extra features"
	default "debug-tweaks"
	depends on USE_PVROOT_IMAGE

config KAS_LOCAL_PVROOT_IMAGE
	string
	default "PVROOT_IMAGE = \"yes\"" if PVROOT_IMAGE

config CONTAINER_PV_CONNMAN
	bool "pv-connman"

config KAS_LOCAL_PV_CONNMAN
	string
	default "PVROOT_CONTAINERS_CORE += \"pv-connman\"" if CONTAINER_PV_CONNMAN

config CONTAINER_PV_PVR_SDK
	bool  "pv-pvr-sdk"

config KAS_LOCAL_PV_PVR_SDK
	string
	default "PVROOT_CONTAINERS_CORE += \"pv-pvr-sdk\"" if CONTAINER_PV_PVR_SDK

config CONTAINER_PV_ALPINE_DBUS
	bool "pv-alpine-dbus"

config KAS_LOCAL_PV_ALPINE_DBUS
	string
	default "PVROOT_CONTAINERS_CORE += \"pv-alpine-dbus\"" if CONTAINER_PV_ALPINE_DBUS

config CONTAINER_PV_ALPINE_CONNMAN
	bool "pv-alpine-connman"

config KAS_LOCAL_PV_ALPINE_CONNMAN
	string
	default "PVROOT_CONTAINERS_CORE += \"pv-alpine-connman\"" if CONTAINER_PV_ALPINE_CONNMAN

config CONTAINER_PV_PVWIFICONNECT
	bool "pv-pvwificonnect"
	depends on CONTAINER_PV_CONNMAN || CONTAINER_PV_DEBIAN_NM || CONTAINER_PV_ALPINE_CONNMAN

config KAS_LOCAL_PV_PVWIFICONNECT
	string
	default "PVROOT_CONTAINERS_CORE += \"pv-pvwificonnect\"" if CONTAINER_PV_PVWIFICONNECT

config CONTAINER_PV_DEBIAN_NM
	bool "pv-debian-nm"

config KAS_LOCAL_PV_DEBIAN_NM
	string
	default "PVROOT_CONTAINERS_CORE += \"pv-debian-nm\"" if CONTAINER_PV_DEBIAN_NM

config CONTAINER_PV_AWCONNECT
	bool  "pv-awconnect"

config KAS_LOCAL_PV_AWCONNECT
	string
	default "PVROOT_CONTAINERS_CORE += \"pv-awconnect\"" if CONTAINER_PV_AWCONNECT

config CONTAINER_PV_TAILSCALE
	bool  "pv-tailscale"

config KAS_LOCAL_PV_TAILSCALE
	string
	default "PVROOT_CONTAINERS_CORE += \"pv-tailscale\"" if CONTAINER_PV_TAILSCALE
endmenu

config MACHINE_FILTER_ALL
	bool "Show All Machines"
	default y

choice
	prompt "Filter Machines"
	default MACHINE_FILTER_QEMU
	depends on MACHINE_FILTER_ALL = n

config MACHINE_FILTER_QEMU
	bool "qemu"

config MACHINE_FILTER_DOCKER
	bool "docker"

config MACHINE_FILTER_VARISCITE
	bool "Variscite"

config MACHINE_FILTER_TORADEX
	bool "Toradex"

config MACHINE_FILTER_NXP
	bool "NXP"

config MACHINE_FILTER_CORAL
	bool "Coral NXP"
	depends on CODENAME_SCARTHGAP

config MACHINE_FILTER_RPI
	bool "Raspberry Pi"

config MACHINE_FILTER_ROCKCHIP
	bool "Rockchip"

config MACHINE_FILTER_SUNXI
	bool "sunxi"

config MACHINE_FILTER_TI
	bool "TI"

config MACHINE_FILTER_RISCV
	bool "RISC-V"

config MACHINE_FILTER_RADXA
	bool "Radxa"

endchoice

config PLATFORM_CORAL
	bool

config PLATFORM_DOCKER
	bool

config PLATFORM_QEMU
	bool

config PLATFORM_RPI
	bool

config PLATFORM_NXP
	bool

config PLATFORM_VARISCITE
	bool

config PLATFORM_TORADEX
	bool

config PLATFORM_TI
	bool

config PLATFORM_RISCV
	bool

config PLATFORM_ROCKCHIP
	bool

config PLATFORM_SUNXI
	bool

config PLATFORM_RADXA
	bool

choice
	prompt "Machine"
	default MACHINE_QEMUARM

config MACHINE_DOCKERX86_64
	bool "dockerX86-64"
	depends on MACHINE_FILTER_ALL || MACHINE_FILTER_DOCKER
	select PLATFORM_DOCKER

config MACHINE_DOCKERARMV8
	bool "dockerarmv8"
	depends on MACHINE_FILTER_ALL || MACHINE_FILTER_DOCKER
	select PLATFORM_DOCKER

config MACHINE_DOCKERARMV6
	bool "dockerarmv6"
	depends on MACHINE_FILTER_ALL || MACHINE_FILTER_DOCKER
	select PLATFORM_DOCKER

config MACHINE_QEMUARM
	bool "qemuarm"
	depends on MACHINE_FILTER_ALL || MACHINE_FILTER_QEMU
	select PLATFORM_QEMU

config MACHINE_QEMUX86_64
	bool "qemux86-64"
	depends on MACHINE_FILTER_ALL || MACHINE_FILTER_QEMU
	select PLATFORM_QEMU

config MACHINE_QEMUMIPS
	bool "qemumips"
	depends on MACHINE_FILTER_ALL || MACHINE_FILTER_QEMU
	select PLATFORM_QEMU

config MACHINE_RPI_ARMV8
	bool "raspberrypi-armv8"
	depends on MACHINE_FILTER_ALL || MACHINE_FILTER_RPI
	select PLATFORM_RPI

config MACHINE_RPI_ARMV7
	bool "raspberrypi-armv7"
	depends on CODENAME_SCARTHGAP
	depends on MACHINE_FILTER_ALL || MACHINE_FILTER_RPI
	select PLATFORM_RPI

config MACHINE_IMX8MN_VAR_SOM
	bool "imx8mn-var-som"
	depends on CODENAME_KIRKSTONE
	depends on MACHINE_FILTER_ALL || MACHINE_FILTER_VARISCITE
	select PLATFORM_VARISCITE

config MACHINE_IMX8MM_VAR_DART
	bool "imx8mm-var-dart"
	depends on CODENAME_KIRKSTONE
	depends on MACHINE_FILTER_ALL || MACHINE_FILTER_VARISCITE
	select PLATFORM_VARISCITE

config MACHINE_IMX8QXP_B0_MEK
	bool "imx8qxp-b0-mek"
	depends on MACHINE_FILTER_ALL || MACHINE_FILTER_NXP
	select PLATFORM_NXP

config MACHINE_IMX8QXP_MEK
	bool "imx8qxp-mek"
	depends on MACHINE_FILTER_ALL || MACHINE_FILTER_NXP
	select PLATFORM_NXP

config MACHINE_COLIBRI_IMX6ULL
        bool "colibri-imx6ull"
        depends on CODENAME_SCARTHGAP
        depends on MACHINE_FILTER_ALL || MACHINE_FILTER_TORADEX
        select PLATFORM_TORADEX

config MACHINE_VERDIN_IMX8MM
        bool "verdin-imx8mm"
        depends on CODENAME_SCARTHGAP
        depends on MACHINE_FILTER_ALL || MACHINE_FILTER_TORADEX
        select PLATFORM_TORADEX

config MACHINE_CORAL_DEV
	bool "Google Coral Dev"
	depends on CODENAME_SCARTHGAP
	depends on MACHINE_FILTER_ALL || MACHINE_FILTER_CORAL
	select PLATFORM_CORAL

config MACHINE_ROCKCHIP_RK3328_EVB
	bool "rockchip rk3328 evb"
	depends on MACHINE_FILTER_ALL || MACHINE_FILTER_ROCKCHIP
	select PLATFORM_ROCKCHIP

config MACHINE_ROCKCHIP_RK3399PRO_EVB
	bool "rockchip rk3399pro evb"
	depends on MACHINE_FILTER_ALL || MACHINE_FILTER_ROCKCHIP
	select PLATFORM_ROCKCHIP

config MACHINE_ROCKCHIP_ROCK64
	bool "rockchip rock64"
	depends on MACHINE_FILTER_ALL || MACHINE_FILTER_ROCKCHIP
	select PLATFORM_ROCKCHIP

config MACHINE_SUNXI_BANANAPI_M2_BERRY
	bool "bananapi m2 berry"
	depends on MACHINE_FILTER_ALL || MACHINE_FILTER_SUNXI
	select PLATFORM_SUNXI

config MACHINE_SUNXI_NANOPI_R1
	bool "sunxi nanopi r1"
	depends on MACHINE_FILTER_ALL || MACHINE_FILTER_SUNXI
	select PLATFORM_SUNXI

config MACHINE_SUNXI_ORANGE_PI_R1
	bool "sunxi orange pi r1"
	depends on MACHINE_FILTER_ALL || MACHINE_FILTER_SUNXI
	select PLATFORM_SUNXI

config MACHINE_SUNXI_ORANGE_PI_ZERO_PLUS2_H3
	bool "sunxi orange pi zero plus2 h3"
	depends on MACHINE_FILTER_ALL || MACHINE_FILTER_SUNXI
	select PLATFORM_SUNXI

config MACHINE_SUNXI_ORANGE_PI_3LTS
	bool "sunxi orange pi 3 lts"
	depends on MACHINE_FILTER_ALL || MACHINE_FILTER_SUNXI
	select PLATFORM_SUNXI

config MACHINE_SUNXI_ORANGE_PI_PC_PLUS
	bool "sunxi orange pi pc plus"
	depends on MACHINE_FILTER_ALL || MACHINE_FILTER_SUNXI
	select PLATFORM_SUNXI

config MACHINE_SUNXI_ORANGE_PI_PC2
	bool "sunxi orange pi pc2"
	depends on MACHINE_FILTER_ALL || MACHINE_FILTER_SUNXI
	select PLATFORM_SUNXI

config MACHINE_TI_AM62XX_EVM
	bool "TI AVM62xx EVM"
	depends on MACHINE_FILTER_ALL || MACHINE_FILTER_TI
	select PLATFORM_TI

config MACHINE_TI_AM62AXX_EVM
	bool "TI AVM62axx EVM"
	depends on MACHINE_FILTER_ALL || MACHINE_FILTER_TI
	select PLATFORM_TI

config MACHINE_TI_AM65XX_EVM
	bool "TI AVM65xx EVM"
	depends on MACHINE_FILTER_ALL || MACHINE_FILTER_TI
	select PLATFORM_TI

config MACHINE_TI_BEAGLEBONE
	bool "TI Beaglebone"
	depends on MACHINE_FILTER_ALL || MACHINE_FILTER_TI
	select PLATFORM_TI

config MACHINE_TI_BEAGLEPLAY
	bool "TI Beagleplay"
	depends on MACHINE_FILTER_ALL || MACHINE_FILTER_TI
	select PLATFORM_TI

config MACHINE_RISCV_VISIONFIVE2
	bool "RISC-V Visionfive2"
	depends on MACHINE_FILTER_ALL || MACHINE_FILTER_RISCV
	select PLATFORM_RISCV

config MACHINE_RADXA_ROCK5A
	bool "radxa rock5a"
	depends on MACHINE_FILTER_ALL || MACHINE_FILTER_RADXA
	select PLATFORM_RADXA

config MACHINE_RADXA_ROCK5B
	bool "radxa rock5b"
	depends on MACHINE_FILTER_ALL || MACHINE_FILTER_RADXA
	select PLATFORM_RADXA

endchoice

config KAS_INCLUDE_MACHINE_QEMUX86_64
	string
	default "kas/machines/qemux86-64.yaml" if MACHINE_QEMUX86_64

config KAS_INCLUDE_MACHINE_QEMUARM
	string
	default "kas/machines/qemuarm.yaml" if MACHINE_QEMUARM

config KAS_INCLUDE_MACHINE_QEMUMIPS
	string
	default "kas/machines/qemumips.yaml" if MACHINE_QEMUMIPS

config KAS_INCLUDE_MACHINE_DOCKERARMV8
	string
	default "kas/machines/docker-armv8.yaml" if MACHINE_DOCKERARMV8

config KAS_INCLUDE_MACHINE_DOCKERARMV6
	string
	default "kas/machines/docker-armv6.yaml" if MACHINE_DOCKERARMV6

config KAS_INCLUDE_MACHINE_DOCKERX86_64
	string
	default "kas/machines/docker-x86_64.yaml" if MACHINE_DOCKERX86_64

config KAS_INCLUDE_MACHINE_RPI_ARMV8
	string
	default "kas/machines/raspberrypi-armv8.yaml" if MACHINE_RPI_ARMV8

config KAS_INCLUDE_MACHINE_RPI_ARMV7
	string
	default "kas/machines/raspberrypi-armv7.yaml" if MACHINE_RPI_ARMV7

config KAS_INCLUDE_MACHINE_IMX8MN_VAR_SOM
	string
	default "kas/machines/imx8mn-var-som.yaml" if MACHINE_IMX8MN_VAR_SOM

config KAS_INCLUDE_MACHINE_IMX8MM_VAR_DART
	string
	default "kas/machines/imx8mm-var-dart.yaml" if MACHINE_IMX8MM_VAR_DART

config KAS_INCLUDE_MACHINE_COLIBRI_IMX6ULL
	string
    default "kas/machines/colibri-imx6ull.yaml" if MACHINE_COLIBRI_IMX6ULL

config KAS_INCLUDE_MACHINE_VERDIN_IMX8MM
	string
    default "kas/machines/verdin-imx8mm.yaml" if MACHINE_VERDIN_IMX8MM

config KAS_INCLUDE_MACHINE_IMX8QXP_B0_MEK
	string
	default "kas/machines/imx8qxp-b0-mek.yaml" if MACHINE_IMX8QXP_B0_MEK

config KAS_INCLUDE_MACHINE_IMX8QXP_MEK
	string
	default "kas/machines/imx8qxp-mek.yaml" if MACHINE_IMX8QXP_MEK

config KAS_INCLUDE_MACHINE_ROCKCHIP_RK3328_EVB
	string
	default "kas/machines/rockchip-rk3328-evb.yaml" if MACHINE_ROCKCHIP_RK3328_EVB

config KAS_INCLUDE_MACHINE_ROCKCHIP_RK3399PRO_EVB
	string
	default "kas/machines/rockchip-rk3399pro-evb.yaml" if MACHINE_ROCKCHIP_RK3399PRO_EVB

config KAS_INCLUDE_MACHINE_ROCKCHIP_ROCK64
	string
	default "kas/machines/rockchip-rock64.yaml" if MACHINE_ROCKCHIP_ROCK64

config KAS_INCLUDE_MACHINE_SUNXI_BANANAPI_M2_BERRY
	string
	default "kas/machines/sunxi-bananapi-m2-berry.yaml" if MACHINE_SUNXI_BANANAPI_M2_BERRY

config KAS_INCLUDE_MACHINE_SUNXI_NANOPI_R1
	string
	default "kas/machines/sunxi-nanopi-r1.yaml" if MACHINE_SUNXI_NANOPI_R1

config KAS_INCLUDE_MACHINE_SUNXI_ORANGE_PI_R1
	string
	default "kas/machines/sunxi-orange-pi-r1.yaml" if MACHINE_SUNXI_ORANGE_PI_R1

config KAS_INCLUDE_MACHINE_SUNXI_ORANGE_PI_ZERO_PLUS2_H3
	string
	default "kas/machines/sunxi-orange-pi-zero-plus2-h3.yaml" if MACHINE_SUNXI_ORANGE_PI_ZERO_PLUS2_H3

config KAS_INCLUDE_MACHINE_SUNXI_ORANGE_PI_3LTS
	string
	default "kas/machines/sunxi-orange-pi-3lts.yaml" if MACHINE_SUNXI_ORANGE_PI_3LTS

config KAS_INCLUDE_MACHINE_SUNXI_ORANGE_PI_PC_PLUS
	string
	default "kas/machines/sunxi-orange-pi-pc-plus.yaml" if MACHINE_SUNXI_ORANGE_PI_PC_PLUS

config KAS_INCLUDE_MACHINE_SUNXI_ORANGE_PI_PC2
	string
	default "kas/machines/sunxi-orange-pi-pc2.yaml" if MACHINE_SUNXI_ORANGE_PI_PC2

config KAS_INCLUDE_MACHINE_CORAL_DEV
	string
	default "kas/machines/coral-dev.yaml" if MACHINE_CORAL_DEV

config KAS_INCLUDE_MACHINE_TI_AM62AXX_EVM
	string
	default "kas/machines/ti-am62axx-evm.yaml" if MACHINE_TI_AM62AXX_EVM

config KAS_INCLUDE_MACHINE_TI_AM62XX_EVM
	string
	default "kas/machines/ti-am62xx-evm.yaml" if MACHINE_TI_AM62XX_EVM

config KAS_INCLUDE_MACHINE_TI_AM65XX_EVM
	string
	default "kas/machines/ti-am65xx-evm.yaml" if MACHINE_TI_AM65XX_EVM

config KAS_INCLUDE_MACHINE_TI_BEAGLEBONE
	string
	default "kas/machines/ti-beaglebone.yaml" if MACHINE_TI_BEAGLEBONE

config KAS_INCLUDE_MACHINE_TI_BEAGLEPLAY
	string
	default "kas/machines/ti-beagleplay.yaml" if MACHINE_TI_BEAGLEPLAY

config KAS_INCLUDE_MACHINE_RISCV_VISIONFIVE2
	string
	default "kas/machines/riscv-visionfive2.yaml" if MACHINE_RISCV_VISIONFIVE2

config KAS_INCLUDE_BUILD_TYPE
	string
	default "kas/appengine-base.yaml" if BUILD_TYPE_APPENGINE || BUILD_TYPE_APPENGINE_CUSTOM
	default "kas/bsp-base.yaml" if BUILD_TYPE_BSP_PLAIN
	default "kas/bsp-multi.yaml" if BUILD_TYPE_BSP_MULTI

config KAS_INCLUDE_CODENAME
	string
	default "kas/kirkstone.yaml" if CODENAME_KIRKSTONE
	default "kas/scarthgap.yaml" if CODENAME_SCARTHGAP

config KAS_INCLUDE_VARISCITE
	string
	default "kas/kirkstone-var.yaml" if CODENAME_KIRKSTONE && (MACHINE_IMX8MN_VAR_SOM || MACHINE_IMX8MM_VAR_DART)


config KAS_INCLUDE_NXP
	string
	default "kas/kirkstone-nxp.yaml" if CODENAME_KIRKSTONE && PLATFORM_NXP
	default "kas/scarthgap-nxp.yaml" if CODENAME_SCARTHGAP && PLATFORM_NXP

config KAS_INCLUDE_SCARTHGAP_FREESCALE
	string
	default "kas/scarthgap-freescale.yaml" if CODENAME_SCARTHGAP && MACHINE_CORAL_DEV

config KAS_INCLUDE_SCARTHGAP_TI
	string
	default "kas/scarthgap-ti.yaml" if CODENAME_SCARTHGAP && PLATFORM_TI

config KAS_INCLUDE_SCARTHGAP_RISCV
	string
	default "kas/scarthgap-riscv.yaml" if CODENAME_SCARTHGAP && PLATFORM_RISCV

config KAS_INCLUDE_MACHINE_RADXA_ROCK5A
	string
	default "kas/machines/radxa-rock5a.yaml" if MACHINE_RADXA_ROCK5A

config KAS_INCLUDE_MACHINE_RADXA_ROCK5B
	string
	default "kas/machines/radxa-rock5b.yaml" if MACHINE_RADXA_ROCK5B
```

## conf/distro/panta-distro-app.conf
```bitbake
require conf/distro/panta-distro.inc

DISTRO = "panta-distro-app"
DISTRO_NAME = "Pantavisor Container App Distro"
DISTRO_VERSION = "${@oe.buildcfg.get_metadata_git_describe(os.path.dirname(os.path.dirname(d.getVar('FILE'))))}"

DISTROOVERRIDES .= ":pvapp"

# we dont need all those full blown images - avoid
# dependencies on linux and uboot which do not work
# nice with linux-dummy
IMAGE_FSTYPES = ""
IMAGE_FSTYPES:append = " tar.gz tar.bz2 tar.xz"

PREFERRED_PROVIDER_virtual/kernel = "linux-dummy"
```

## conf/distro/panta-distro-rd.conf
```bitbake
orig_PP := "${PREFERRED_PROVIDER_virtual/kernel}"

require conf/distro/poky-tiny.conf

PREFERRED_PROVIDER_virtual/kernel = "${orig_PP}"

DISTRO = "panta-distro-rd"
DISTRO_NAME = "Pantavisor Inintramfs Distro"
DISTRO_VERSION = "019"

ENABLE_WIDEC = "true"

# NO_RECOMMENDATIONS = "1"

PREFERRED_VERSION_mbedtls = "2.28.%"

BUSYBOX_VERSION_kirkstone = "1.36~pv.%"
BUSYBOX_VERSION_scarthgap = "1.36~pv.%"
PREFERRED_VERSION_busybox = "${@d.getVar("BUSYBOX_VERSION_${DISTRO_CODENAME}", expand=True)}"

#PREFERRED_PROVIDER_virtual/kernel = "linux-dummy"
#PREFERRED_PROVIDER_virtual/bootloader = "u-boot-dummy"

TI_COMMON_DEPLOY = "${TMPDIR}/deploy"
DISTRO_FEATURES = "pantavisor-initramfs"
```
